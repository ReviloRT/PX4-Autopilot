## src/drivers/force_sensor/Kconfig
```kconfig
menu "Force Sensors"
    menuconfig COMMON_FORCE_SENSOR
        bool "Common force sensor modules"
        default n
        select DRIVERS_FORCE_SENSOR_NAU7802
        ---help---
            Enable default set of force sensor drivers
    rsource "*/Kconfig"
endmenu
```

## src/drivers/force_sensor/nau7802/Kconfig
```kconfig
menuconfig DRIVERS_FORCE_SENSOR_NAU7802
	bool "nau7802"
	default n
	---help---
		Enable support for nau7802
```
